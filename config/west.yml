## config/west.yml
```yaml
manifest:
  remotes:
    - name: slicemk
      url-base: https://github.com/slicemk
    - name: ssbb
      url-base: https://github.com/ssbb
  projects:
    - name: zmk
      remote: slicemk
      revision: v20250729-rgb
      import: app/west.yml
    - name: zmk-listeners
      remote: ssbb
      revision: v1
  self:
    path: config
```
